## boards/shields/protopad/Kconfig.defconfig
```kconfig
# Copyright (c) 2024 Joshua Wiens
# SPDX-License-Identifier: MIT

if SHIELD_PROTOPAD

config ZMK_KEYBOARD_NAME
    default "Protopad 9"

endif
```

## boards/shields/protopad/Kconfig.shield
```kconfig
# Copyright (c) 2024 Joshua Wiens
# SPDX-License-Identifier: MIT

config SHIELD_PROTOPAD
    def_bool $(shields_list_contains,protopad)
```
